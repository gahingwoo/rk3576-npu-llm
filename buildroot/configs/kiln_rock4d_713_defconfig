## buildroot/configs/kiln_rock4d_713_defconfig
```kconfig
BR2_aarch64=y

# Buildroot-internal glibc toolchain (external /usr toolchain breaks on Ubuntu
# 24.04 aarch64; same choice as the rocket tree's rock4d_npu_defconfig).
BR2_TOOLCHAIN_BUILDROOT_GLIBC=y
BR2_KERNEL_HEADERS_6_6=y
BR2_TOOLCHAIN_BUILDROOT_CXX=y
# RK3576 = Cortex-A72 + Cortex-A53, both ARMv8.0-A (no LSE atomics).
BR2_TARGET_OPTIMIZATION="-mcpu=cortex-a72.cortex-a53"

BR2_TARGET_GENERIC_HOSTNAME="rock4d-kiln"
BR2_TARGET_GENERIC_ISSUE="Kiln RK3576 NPU (vendor rknpu + RKLLM on mainline)"
BR2_SYSTEM_DHCP="eth0"
BR2_TARGET_GENERIC_ROOT_PASSWD="root"
BR2_INIT_BUSYBOX=y

# Kiln post-build: build+install out-of-tree rknpu.ko, install runtimes, model.
# The Kiln repo path is passed as the post-script arg.
# Overlay: /usr/bin/kiln-chat + /etc/profile.d/kiln-chat.sh (login -> NPU chat).
BR2_ROOTFS_OVERLAY="$(BR2_EXTERNAL_KILN_PATH)/rootfs"
BR2_ROOTFS_POST_BUILD_SCRIPT="$(BR2_EXTERNAL_KILN_PATH)/board/rock4d/post-build.sh"
BR2_ROOTFS_POST_IMAGE_SCRIPT="$(BR2_EXTERNAL_KILN_PATH)/board/rock4d/post-image.sh"
BR2_ROOTFS_POST_SCRIPT_ARGS="$(BR2_EXTERNAL_KILN_PATH)/.."

BR2_LINUX_KERNEL=y
# Kernel source overridden at build time via LINUX_OVERRIDE_SRCDIR in the
# generated local.mk (points at the linux-next tree with platform patches).
BR2_LINUX_KERNEL_CUSTOM_VERSION=y
BR2_LINUX_KERNEL_CUSTOM_VERSION_VALUE="7.1.3-kiln"
BR2_LINUX_KERNEL_USE_CUSTOM_CONFIG=y
# base.config is copied into dl/ by build-image.sh from the kernel tree.
BR2_LINUX_KERNEL_CUSTOM_CONFIG_FILE="$(BR2_EXTERNAL_KILN_PATH)/dl/base.config"
# Kiln fragment turns CONFIG_DRM_ACCEL_ROCKET off (vendor rknpu binds the NPU).
BR2_LINUX_KERNEL_CONFIG_FRAGMENT_FILES="$(BR2_EXTERNAL_KILN_PATH)/npu.fragment"
BR2_LINUX_KERNEL_IMAGE_TARGET_CUSTOM=y
BR2_LINUX_KERNEL_IMAGE_TARGET_NAME="Image"
BR2_LINUX_KERNEL_DTS_SUPPORT=y
# The vendor rknpu node + IOMMUs are added to the in-tree rk3576-rock-4d dtb by
# kernel-patches/0004 (KERNEL_SRC must have 0001-0010 applied); clk_npu via CRU
# (not SCMI). So we build the stock in-tree DTS name, no custom/overlay DTS.
BR2_LINUX_KERNEL_INTREE_DTS_NAME="rockchip/rk3576-rock-4d"
BR2_LINUX_KERNEL_NEEDS_HOST_OPENSSL=y
BR2_LINUX_KERNEL_INSTALL_TARGET=y

BR2_PACKAGE_BUSYBOX=y
BR2_PACKAGE_DROPBEAR=y
# librkllmrt/librknnrt need libstdc++/libgomp/pthread (in the toolchain) + libdrm
# (librkllmrt statically links its own libdrm, but libdrm on target is harmless).
BR2_PACKAGE_LIBDRM=y

BR2_TARGET_ROOTFS_EXT2=y
BR2_TARGET_ROOTFS_EXT2_4=y
# 1536 MiB: fits the 668 MB model baked into /opt/models + libs + rknpu.ko + demo
# + ext4 headroom (build uses KILN_BAKE_MODEL=1). Drop to 768M and unset
# KILN_BAKE_MODEL to keep the model out and scp it instead.
BR2_TARGET_ROOTFS_EXT2_SIZE="2560M"
```
